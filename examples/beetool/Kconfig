## examples/beetool/Kconfig
```kconfig
menu "endpoint configuration"
# endpoint 1
config EP1_ENABLE
	bool "Enable endpoint 1"

config EP1_IN
	bool "Enable IN on endpoint 1"
	depends on EP1_ENABLE

config EP1_OUT
	bool "Enable OUT on endpoint 1"
	depends on EP1_ENABLE

# endpoint 2
config EP2_ENABLE
	bool "Enable endpoint 2"

config EP2_IN
	bool "Enable IN on endpoint 2"
	depends on EP2_ENABLE

config EP2_OUT
	bool "Enable OUT on endpoint 2"
	depends on EP2_ENABLE

# endpoint 3
config EP3_ENABLE
	bool "Enable endpoint 3"

config EP3_IN
	bool "Enable IN on endpoint 3"
	depends on EP3_ENABLE

config EP3_OUT
	bool "Enable OUT on endpoint 3"
	depends on EP3_ENABLE

# endpoint 4
config EP4_ENABLE
	bool "Enable endpoint 4"

config EP4_IN
	bool "Enable IN on endpoint 4"
	depends on EP4_ENABLE

config EP4_OUT
	bool "Enable OUT on endpoint 4"
	depends on EP4_ENABLE
endmenu

menu "prebaked protocols"

config CDC_ACM
	bool "CDC ACM serial port"
	depends on UART

config CDC_ACM_DEBUG
	bool "Output CDC ACM debug strings"
	depends on CDC_ACM

choice
	prompt "CDC ACM notification endpoint"
	depends on CDC_ACM
	
config CDC_ACM_NOTIFICATION_EP1
	bool "endpoint 1"

config CDC_ACM_NOTIFICATION_EP2
	bool "endpoint 2"
	
config CDC_ACM_NOTIFICATION_EP3
	bool "endpoint 3"

endchoice	

choice
	prompt "CDC ACM data endpoint"
	depends on CDC_ACM

config CDC_ACM_DATA_EP1
	bool "endpoint 1"
	depends on !CDC_ACM_CTRL_EP1

config CDC_ACM_DATA_EP2
	bool "endpoint 2"
	depends on !CDC_ACM_CTRL_EP2
	
endchoice

config I2C_TINY
	bool "i2c tiny emulation"

endmenu

# uart
menu "uart"

config UART
	bool "Enable interrupt controlled uart driver"

config UART_BUFSZ
	int "size of each tx and rx buffer"
	default 32

endmenu

menu "debugging options"

config USB_PKTDBG
	bool "Low level packet debugging"

endmenu
```
